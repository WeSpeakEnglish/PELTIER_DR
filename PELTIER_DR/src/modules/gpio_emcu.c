/******************************************************************************

   Файл модуля работы с GPIO
   Содержит функции для наиболее употребительных действий с GPIO.

 ******************************************************************************
   Общие сведения.
   - в качестве параметра функции передаётся
   указатель на базовый адрес порта *PORTX (совпадает с адресом регистра GPIOX->CRL)

   - обращение к управляющим регистрам порта задаётся через смещение относительно базового адреса
   - для обозначения структуры аргументов передаваемых в макросы и функции 
    в конце имён указаны префиксы:
   _m - передаётся битовая маска, возможна работа с несколькими битами;
   _b - передаётся номер бита, работа с одним из битов порта;


 ******************************************************************************/


#include "gpio_emcu.h"

//    Указатели на базовые адреса GPIO.
u32   *PORTA= (u32*)(&GPIOA->CRL); // APB2PERIPH_BASE + 0x0800.
u32   *PORTB= (u32*)(&GPIOB->CRL); // ... + 0x0C00.
u32   *PORTC= (u32*)(&GPIOC->CRL); // ... + 0x1000.
u32   *PORTD= (u32*)(&GPIOD->CRL); // ... + 0x1400. 
u32   *PORTE= (u32*)(&GPIOE->CRL); // ... + 0x1800. 
u32   *PORTF= (u32*)(&GPIOF->CRL); // ... + 0x1C00. 
u32   *PORTG= (u32*)(&GPIOG->CRL); // ... + 0x2000.


// Настройка вывода на двухтактный PushPull - выход.
void PinOutPP_b (u32 *adr, u8 bit)
{
   if (bit<=7) {*adr|=3<<(bit<<2); *adr&=~(3<<((bit<<2)+2));} // Биты MODE=11 и CNF=00.
   else {*(adr+1)|=3<<((bit-8)<<2); *(adr+1)&=~(3<<(((bit-8)<<2))+2);}
}
// Настройка вывода на выход c открытым стоком OpenDrain.
void PinOutOD_b (u32 *adr, u8 bit)
{
   if (bit<=7) {*adr|=3<<(bit<<2); *adr&=~(3<<((bit<<2)+2)); *adr|=(1<<((bit<<2)+2));} // Биты MODE=11 и CNF=01.
   else {*(adr+1)|=3<<((bit-8)<<2); *(adr+1)&=~(3<<(((bit-8)<<2))+2); *(adr+1)|=(1<<(((bit-8)<<2))+2);} 
}
// Настройка вывода на вход в третьем Z-состоянии.
void PinInputZ_b (u32 *adr, u8 bit)
{
   if (bit<=7) {*adr&=~(3<<(bit<<2)); *adr&=~(3<<((bit<<2)+2)); *adr|=(1<<((bit<<2)+2));} // Биты MODE=00 и CNF=01.
   else {*(adr+1)&=3<<~(((bit-8)<<2)); *(adr+1)&=~(3<<(((bit-8)<<2))+2); *(adr+1)|=(1<<(((bit-8)<<2))+2);}
}
// Настройка вывода на выход с альтернативной функцией.
void PinOutAF_b (u32 *adr, u8 bit)
{
   if (bit<=7) {*adr|=3<<(bit<<2); *adr&=~(3<<((bit<<2)+2)); *adr|=(2<<((bit<<2)+2));} // Биты MODE=11 и CNF=01.
   else {*(adr+1)|=3<<((bit-8)<<2); *(adr+1)&=~(3<<(((bit-8)<<2))+2); *(adr+1)|=(2<<(((bit-8)<<2))+2);} 
}

/******************************************************************************

   Примеры:

   #define KEY    0 // Кнопка на PA0.
   #define LED3   9 // Светодиод LED3 на PC9.
   #define LED4   8 // Светодиод LED4 на PC8.

   PinOutPP_b (PORTC, LED3); // Вывод LED3 - двухтактный выход.
   PinOutPP_b (PORTC, LED4); // Вывод LED4 - двухтактный выход.
   PinInputZ_b (PORTA, KEY); // Вывод копки на вход.

 ******************************************************************************/

