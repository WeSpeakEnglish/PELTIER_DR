/******************************************************************************

    hd44780_emcu.с - модуь символьного ЖКИ на основе hd44780.
    Author: eugenemcu.ru. Date: 22.03.2011.

    Примечания: отсутствует поддержка режима чтения с ЖКИ. Сигнал LCD_RW модуля подключен к общему.
    Младшие разряды шины данных модуля DB0...DB3 свободны или подключены к общему.
    Нумерация позиций вывода сквозная (без различия строк). Для модуля 2x16 - 0...31, 
    где 0...15 - строка 1, 16-31 - строка 2.

*******************************************************************************/

    #include "gpio_emcu.h"
    #include "hd44780_emcu.h"

/*------------------------------------------------------------------------------
    Имя:        LCD_CMD - отправка байта в командном режиме (LCD_CD=0).
    Описание:   Отправляет модулю код команды в режиме доступа 4 бит.
    Параметры:  CMD - код команды.
------------------------------------------------------------------------------*/    
void LCD_CMD (u32 CMD) // Передача команды LCD.
{
     volatile u32 tmp0;
    _cpin_m (LCD_D_PORT,LCD_D_MASK); // Сбросить биты шины данных.
    _spin_m (LCD_D_PORT,((CMD>>4)<<LCD_D_SHIFT)); // Установить единичные биты старшей тетрады.
    _spin_m (LCD_C_PORT,1<<LCD_EN); // LCD_EN=1.
    _cpin_m (LCD_C_PORT,1<<LCD_EN); // LCD_EN=0.
    _cpin_m (LCD_D_PORT,LCD_D_MASK); // Сбросить биты шины данных.
    _spin_m (LCD_D_PORT,((CMD&0x0F)<<LCD_D_SHIFT)); // Установить единичные биты младшей тетрады.    
    _spin_m (LCD_C_PORT,1<<LCD_EN); // LCD_EN=1.
    _cpin_m (LCD_C_PORT,1<<LCD_EN); // LCD_EN=0.
    tmp0=(SYSCLK_FREQ/500); while (tmp0) tmp0--; 
}
/*------------------------------------------------------------------------------
    Имя:        LCD_DAT - отправка байта в режиме данных (LCD_CD=1).
    Описание:   Отправляет модулю байт данных в режиме доступа 4 бит.
    Параметры:  DAT - байт данных.
------------------------------------------------------------------------------*/    
void LCD_DAT (u32 DAT) // Запись данных в LCD.
{
    volatile u32 tmp0;
    _cpin_m (LCD_D_PORT,LCD_D_MASK); // Сбросить биты шины данных.
    _spin_m (LCD_D_PORT,((DAT>>4)<<LCD_D_SHIFT)); // Установить единичные биты старшей тетрады.      
    _spin_m (LCD_C_PORT,1<<LCD_EN|1<<LCD_CD); // LCD_EN=1, LCD_CD=1.
    _cpin_m (LCD_C_PORT,1<<LCD_EN); // LCD_EN=0.
    _cpin_m (LCD_D_PORT,LCD_D_MASK); // Сбросить биты шины данных.
    _spin_m (LCD_D_PORT,((DAT&0x0F)<<LCD_D_SHIFT)); // Установить единичные биты младшей тетрады.      
    _spin_m (LCD_C_PORT,1<<LCD_EN|1<<LCD_CD); // LCD_EN=1, LCD_CD=1.
    _cpin_m (LCD_C_PORT,1<<LCD_EN|1<<LCD_CD); // LCD_EN=0, LCD_CD=0.
    tmp0=(SYSCLK_FREQ/1000); while (tmp0) tmp0--;    
}
/*------------------------------------------------------------------------------
    Имя:        LCD_GOTO - установка текущей позиции вывода.
    Описание:   Отправляет модулю адрес текущей позиции отображения символа.
    Параметры:  ADR - адрес знакоместа.
------------------------------------------------------------------------------*/
void LCD_GOTO (u32 ADR)
{
    if (ADR>=CHAR_IN_LINE) ADR=ADR+64-(CHAR_IN_LINE); // Переход на новую строку.
    LCD_CMD (ADR|(1<<7)); // Установить адрес для отображения в DDRAM.                                                                  // Отобразить данные.                                                    
}
/*------------------------------------------------------------------------------
    Имя:        LCD_CHAR.
    Описание:   Оображает символ на выбранной позиции.
    Параметры:  ADR - адрес позиции для отбражения, DAT - код символа.
------------------------------------------------------------------------------*/
void LCD_CHAR (u32 ADR, u32 DAT) // Отображение символа DAT по адресу ADR. 
{
    LCD_GOTO (ADR);
    LCD_DAT (DAT); // Отобразить данные.                                                    
}
/*------------------------------------------------------------------------------
    Имя:        LCD_INIT.
    Описание:   Настройка портов на работу с ЖКИ. 
    Перевод модуля в режим шины 4 бит и т.д.
------------------------------------------------------------------------------*/
void LCD_INIT (void)
{
    PinOutPP_b (LCD_C_PORT,LCD_EN); // LCD_EN на выход.
    PinOutPP_b (LCD_C_PORT,LCD_CD); // LCD_CD на выход.
    PinOutPP_b (LCD_C_PORT,LCD_RW); // LCD_RW на выход.
    _cpin_m(LCD_C_PORT,1<<LCD_EN|1<<LCD_CD|1<<LCD_RW); // Сброс.
    PinOutPP_b (LCD_D_PORT,LCD_D_SHIFT);
    PinOutPP_b (LCD_D_PORT,LCD_D_SHIFT+1);
    PinOutPP_b (LCD_D_PORT,LCD_D_SHIFT+2);
    PinOutPP_b (LCD_D_PORT,LCD_D_SHIFT+3);
    LCD_CMD (0x02); // Шина 4 бит. (LCD пока в режиме 8 бит).
    LCD_CMD (0x28); // Шина 4 бит, 2 строки, 5*8 пикселей.
    LCD_VIEW_MODE (ON, ON, OFF);
    LCD_CMD (0x01); // Очистить дисплей.
}
/*------------------------------------------------------------------------------
    Имя:        LCD_STRING - отображение строки.
    Описание:   Отображает строку начиная с выбранной позиции.
    Параметры:  ADR - адрес начальной позиции, *STRING - указатель на строковую константу.
    Пример вызова: LCD_STRING (0, "TEST"); // Строка "TEST" начиная со знакоместа 0.
------------------------------------------------------------------------------*/
void LCD_STRING (u32 ADR, u8 *STRING)    // Отображение символа DAT по адресу ADR. 
{
    LCD_GOTO (ADR);
    while (*STRING) {LCD_DAT (*STRING); STRING++;}                                               
}
/*------------------------------------------------------------------------------
    Имя:        LCD_VIEW_MODE - изменение параметров отображения.
    Описание:   Разрешает/запрещает отображение и курсоры.
    Параметры:  cursor1: 1 - разрешить, 0-запретить отображение курсора подчёркиванием;
                cursor2: 1 - разрешить, 0-запретить отображение курсора в виде мигающего знакоместа;
                view_on: 1 - разрешить, 0-запретить отображение содержимого памяти. 
------------------------------------------------------------------------------*/
void LCD_VIEW_MODE (u32 cursor1, u32 cursor2, u32 view_on)
{
    u32 tmp=(1<<3); //  Отображение включено.
    if (cursor1) tmp|=(1<<1); // Курсор в виде подчерка.
    if (cursor2) tmp|=(1<<0); // Курсор в виде мигающего знакоместа.
    if (view_on) tmp|=(1<<2); // Разрешить отображение.
    LCD_CMD (tmp);
}
/*------------------------------------------------------------------------------
    Имя:        CREATE_CHAR  - создание нового символа.
    Описание:   Сохраняет новый символ по заданному адресу знакогенератора .
    Параметры:  ADR - адрес нового символа (0x00...0x07).
    Y1...Y8: -  младшие пять разрядов этих параметров - горизонтальные строки пикселей символа:

    ***** - 0x1F
        * - 0x01
        * - 0x01
      *** - 0x07
        * - 0x01
    ***** - 0x1F
          - 0x00
    ***** - 0x1F - позиции подчёркивания.
------------------------------------------------------------------------------*/
void CREATE_CHAR (char ADR, char Y1,char Y2,char Y3,char Y4,char Y5,char Y6,char Y7,char Y8)
{
    ADR=ADR<<3; // Вычисляем адрес в CGRAM=ADR*8.
    LCD_CMD (ADR|(1<<6)); // Установить адрес для записи в CGRAM.
    LCD_DAT (Y1); LCD_DAT (Y2); LCD_DAT (Y3); LCD_DAT (Y4);
    LCD_DAT (Y5); LCD_DAT (Y6); LCD_DAT (Y7); LCD_DAT (Y8);
}